## src/examples/hello_test/Kconfig
```kconfig
menuconfig EXAMPLES_HELLO_TEST
	bool "hello_test"
	default n
	---help---
		Enable support for hello_test
```

## src/examples/hexcopterbsctrl/Kconfig
```kconfig
menuconfig EXAMPLES_HEXCOPTERBSCTRL
	bool "hexcopterbsctrl"
	default n
	---help---
		Enable support for hexcopterbsctrl
```

## src/examples/motor_eff_ctrl/Kconfig
```kconfig
menuconfig EXAMPLES_MOTOR_EFF_CTRL
	bool "motor_eff_ctrl"
	default n
	---help---
		Enable support for motor_eff_ctrl
```

## src/examples/motor_efficiency_publish/Kconfig
```kconfig
menuconfig EXAMPLES_MOTOR_EFFICIENCY_PUBLISH
	bool "motor_efficiency_publish"
	default n
	---help---
		Enable support for motor_efficiency_publish
```

## src/examples/motor_test_listen/Kconfig
```kconfig
menuconfig EXAMPLES_MOTOR_TEST_LISTEN
	bool "motor_test_listen"
	default n
	---help---
		Enable support for motor_test_listen
```

## src/examples/order_publish/Kconfig
```kconfig
menuconfig EXAMPLES_ORDER_PUBLISH
	bool "order_publish"
	default n
	---help---
		Enable support for order_publish
```

## src/examples/posatt_listen/Kconfig
```kconfig
menuconfig EXAMPLES_POSATT_LISTEN
	bool "posatt_listen"
	default n
	---help---
		Enable support for posatt_listen
```

## src/examples/px4_app_test/Kconfig
```kconfig
menuconfig EXAMPLES_PX4_APP_TEST
	bool "px4_first_move"
	default n
	---help---
		Enable support for px4_first_move
```

## src/examples/px4_listening_test/Kconfig
```kconfig
menuconfig EXAMPLES_PX4_LISTENING_TEST
	bool "px4_listening_test"
	default n
	---help---
		Enable support for px4_listening_test
```

## src/examples/quadcopterbsctrl/Kconfig
```kconfig
menuconfig EXAMPLES_QUADCOPTERBSCTRL
	bool "quadcopterbsctrl"
	default n
	---help---
		Enable support for quadcopterbsctrl
```

## src/examples/quadqmodelbsctrl/Kconfig
```kconfig
menuconfig EXAMPLES_QUADQMODELBSCTRL
	bool "quadqmodelbsctrl"
	default n
	---help---
		Enable support for quadqmodelbsctrl
```

## src/examples/servo_test/Kconfig
```kconfig
menuconfig EXAMPLES_SERVO_TEST
	bool "servo_test"
	default n
	---help---
		Enable support for servo_test
```

## src/examples/setpoint_listen/Kconfig
```kconfig
menuconfig EXAMPLES_SETPOINT_LISTEN
	bool "setpoint_listen"
	default n
	---help---
		Enable support for setpoint_listen
```

## src/examples/thrust_setpoint_listen/Kconfig
```kconfig
menuconfig EXAMPLES_THRUST_SETPOINT_LISTEN
	bool "thrust_setpoint_listen"
	default n
	---help---
		Enable support for thrust_setpoint_listen
```

## src/examples/uniftcctrl/Kconfig
```kconfig
menuconfig EXAMPLES_UNIFTCCTRL
	bool "uniftcctrl"
	default n
	---help---
		Enable support for uniftcctrl
```
